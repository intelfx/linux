## drivers/gpu/drm/dove/Kconfig
```kconfig
config DRM_DOVE
	tristate "DRM Support for Marvell Dove"
	depends on DRM && MACH_DOVE
	depends on OF
	select DRM_KMS_HELPER
	select DRM_KMS_CMA_HELPER
	select DRM_GEM_CMA_HELPER
	help
	  Choose this option if you have a Marvell Dove chipset.
	  If M is selected the module will be called dove-drm.
```

## fs/lanyfs/Kconfig
```kconfig
config LANYFS_FS
	tristate "Lanyard file system (LanyFS) (EXPERIMENTAL)"
	help
	  The lanyard file system (LanyFS) is designed for removable storage
	  devices, particularly those small gadgets one would carry around
	  using a lanyard.

	  LanyFS is highly experimental.

	  If unsure, say N.

config LANYFS_DEBUG
	bool "LanyFS debugging support"
	depends on LANYFS_FS
	select DEBUG
	help
	  Enables debugging for the lanyard file system (LanyFS).

	  Selecting Y will produce a lot of kernel messages and it will slow
	  down the system while accessing LanyFS-formatted devices.
```
